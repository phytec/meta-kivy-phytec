## conf/layer.conf
```bitbake
# We have a conf and classes directory, add to BBPATH
BBPATH .= ":${LAYERDIR}"

# We have recipes-* directories, add to BBFILES
BBFILES += "${LAYERDIR}/recipes-*/*/*.bb \
            ${LAYERDIR}/recipes-*/*/*.bbappend"

BBFILE_COLLECTIONS += "meta-phykivy"
BBFILE_PATTERN_meta-phykivy = "^${LAYERDIR}/"
BBFILE_PRIORITY_meta-phykivy = "27"

LAYERDEPENDS_meta-phykivy = "core"
LAYERSERIES_COMPAT_meta-phykivy = "kirkstone"
```
